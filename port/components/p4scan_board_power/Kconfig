## port/components/p4scan_feedback/Kconfig
```kconfig
menu "P4SCAN Status LED"

    config P4SCAN_STATUS_LED_GPIO
        int "WS2812 status LED GPIO"
        range 0 54
        default 51
        help
            GPIO connected to the data input of the WS2812 status LED.

    config P4SCAN_STATUS_LED_COUNT
        int "WS2812 LED count"
        range 1 64
        default 1
        help
            Number of addressable LEDs in the status LED chain.

    config P4SCAN_STATUS_LED_BRIGHTNESS
        int "WS2812 status LED brightness"
        range 0 255
        default 32
        help
            Global RGB brightness limit from 0 to 255.

endmenu
```

## port/components/xcr_decoder/Kconfig
```kconfig
menu "XCR decoder"

config XCR_ENABLE_CODE128
    bool "Enable Code128"
    default y

config XCR_ENABLE_UPC_EAN
    bool "Enable UPC/EAN"
    default y

config XCR_ENABLE_QR
    bool "Enable QR and Micro QR"
    default y

config XCR_ENABLE_DATAMATRIX
    bool "Enable DataMatrix"
    default y

config XCR_DATAMATRIX_ONLY
    bool "Use DataMatrix-only decoder mode"
    default y
    help
        Selects DataMatrix as the active decoder mode in the P4 camera
        application. QR and other decoder sources remain compiled and can
        be re-enabled by selecting a different mode in the application.

config XCR_DATAMATRIX_LIBDMTX
    bool "Use libdmtx DataMatrix backend"
    depends on XCR_ENABLE_DATAMATRIX
    default n

config XCR_POLARITY_RETRY
    bool "Retry dark-background images after inversion"
    default y

config XCR_CROSS_SYMBOLOGY_VETO
    bool "Reject structurally valid Codablock F before Code128 output"
    default y

config XCR_REJECT_AMBIGUOUS_RETAIL_NUMERIC
    bool "Reject invalid retail-length numeric Code128 candidates"
    default y

config XCR_DECODER_TIMEOUT_MS
    int "Per Code128 direction timeout (ms)"
    range 1 10000
    default 2000

config XCR_IMAGE_BUDGET_MS
    int "Whole image deadline (ms)"
    range 1 30000
    default 10000

config XCR_CODE128_DIRECTION_ATTEMPTS
    int "Ranked Code128 direction attempts"
    range 1 16
    default 2

endmenu
```

## port/standalone_idf_test/main/Kconfig.projbuild
```kconfig
menu "P4SCAN Application"

    config P4SCAN_REALTIME_PIPELINE
        bool "Capture on core0 while core1 decodes only the latest pending frame"
        default y
        depends on P4SCAN_CONTINUOUS_SCAN

    config P4SCAN_FRAME_MAX_AGE_MS
        int "Maximum localization frame age from driver completion (ms)"
        range 20 30000
        default 100
        depends on P4SCAN_REALTIME_PIPELINE

    config P4SCAN_FRAME_STAGE_PIPELINE
        bool "Full-frame marker search on core0, decode backend on core1"
        default y
        depends on P4SCAN_REALTIME_PIPELINE && XCR_DATAMATRIX_ONLY && !XCR_DATAMATRIX_LIBDMTX

    config P4SCAN_PIPELINE_DIAGNOSTICS
        bool "Print detailed pipeline timing and CPU samples on the diagnostic serial port"
        default n
        help
            Synchronous diagnostic output can block decoding for multiple frame periods.
            CDC timing and CPU messages remain available when this is disabled.

    config P4SCAN_CONTINUOUS_SCAN
        bool "Continuously capture and search QR codes for AGV operation"
        default n
        depends on P4SCAN_CAMERA_APP

    config P4SCAN_QR_FAST_SEARCH
        bool "Reject frames without QR candidates at 8x and 4x sampling"
        default n
        depends on P4SCAN_CAMERA_APP

    config P4SCAN_CAMERA_APP
        bool "Run OV9281 live capture and XCF decoder"
        default y
        help
            Capture RAW8 frames from the OV9281 camera and pass owned
            Gray8 frames to the XCF decoder. Disable this option to build the
            fixed-sample regression application instead.

    config P4SCAN_TRIGGER_GPIO
        int "Scan trigger button GPIO"
        range 0 54
        default 35
        depends on P4SCAN_CAMERA_APP
        help
            Active-low scan trigger button GPIO. The target hardware uses GPIO35
            with an external pull-up and the button connected to ground.

    config P4SCAN_LIGHT_DIAGNOSTIC
        bool "Run startup aiming and illumination light diagnostic"
        default y
        depends on P4SCAN_CAMERA_APP
        help
            Cycle PCA9538A P3 and P4 independently at startup so the physical
            light mapping and polarity can be checked on the target board.

    config P4SCAN_SOFTWARE_TRIGGER_ON_BOOT
        bool "Trigger one software scan after boot"
        default n
        depends on P4SCAN_CAMERA_APP
        help
            Issue one scan request after the camera and button tasks start.
            This is intended for hardware diagnostics without pressing GPIO35.

    config P4SCAN_DUMP_FRAME_TO_FLASH
        bool "Dump captured frame and first ROI to samples partition"
        default n
        depends on P4SCAN_CAMERA_APP
        help
            Store one captured 1280x720 Gray8 frame and the first selected
            1280x128 ROI in the samples partition for offline diagnosis.
            Diagnostic use only.

endmenu
```

## sdkconfig.defaults
```kconfig
CONFIG_IDF_TARGET="esp32p4"
CONFIG_FREERTOS_HZ=1000
CONFIG_ESPTOOLPY_FLASHSIZE_16MB=y
CONFIG_SPIRAM=y
CONFIG_SPIRAM_MODE_HEX=y
CONFIG_SPIRAM_USE_MALLOC=y
CONFIG_SPIRAM_MALLOC_ALWAYSINTERNAL=16384
CONFIG_SPIRAM_SPEED_200M=y
CONFIG_IDF_EXPERIMENTAL_FEATURES=y
CONFIG_PARTITION_TABLE_CUSTOM=y
CONFIG_PARTITION_TABLE_CUSTOM_FILENAME="partitions.csv"
CONFIG_COMPILER_OPTIMIZATION_PERF=y
CONFIG_LOG_DEFAULT_LEVEL_INFO=y
CONFIG_ESP_MAIN_TASK_STACK_SIZE=8192
CONFIG_ESP_TASK_WDT_EN=n

# OV9281: 2-lane MIPI CSI, 24 MHz XCLK, 1280x720 RAW8 at 50 fps.
CONFIG_P4SCAN_CAMERA_APP=y
CONFIG_P4SCAN_CONTINUOUS_SCAN=y
CONFIG_P4SCAN_QR_FAST_SEARCH=y
CONFIG_P4SCAN_TRIGGER_GPIO=35
CONFIG_P4SCAN_LIGHT_DIAGNOSTIC=n
CONFIG_P4SCAN_SOFTWARE_TRIGGER_ON_BOOT=n
CONFIG_P4SCAN_DUMP_FRAME_TO_FLASH=n
CONFIG_CAMERA_OV9281=y
CONFIG_CAMERA_OV9281_AUTO_DETECT_MIPI_INTERFACE_SENSOR=y
CONFIG_CAMERA_OV9281_MIPI_RAW8_640X400_100FPS=y
CONFIG_CAMERA_OV9281_SID_LOW=y
CONFIG_CAMERA_OV9281_ABSOLUTE_GAIN_LIMIT=4000
CONFIG_ESP_VIDEO_ENABLE_MIPI_CSI_VIDEO_DEVICE=y
CONFIG_ESP_VIDEO_ENABLE_ISP=y
CONFIG_ESP_VIDEO_ENABLE_ISP_PIPELINE_CONTROLLER=y
CONFIG_ESP_VIDEO_DISABLE_MIPI_CSI_DRIVER_BACKUP_BUFFER=y
CONFIG_TINYUSB_RHPORT_HS=y
CONFIG_TUSB_PID=0x8001
CONFIG_TUSB_PRODUCT="P4SCAN OV9281 UVC+CDC"
CONFIG_UVC_MODE_ISOC_CAM1=y
CONFIG_UVC_CAM1_FRAMESIZE_WIDTH=1280
CONFIG_UVC_CAM1_FRAMESIZE_HEIGT=720
CONFIG_UVC_CAM1_MULTI_FRAMESIZE=n
CONFIG_UVC_TINYUSB_TASK_CORE=0
CONFIG_UVC_CAM1_TASK_CORE=0
CONFIG_CAMERA_OV9281_MIPI_RAW8_1280X720_50FPS=y
CONFIG_CAMERA_OV9281_MIPI_DEFAULT_FMT_RAW8_1280X720_50FPS=y
CONFIG_UVC_CAM1_FRAMERATE=30
CONFIG_FREERTOS_GENERATE_RUN_TIME_STATS=y
CONFIG_FREERTOS_RUN_TIME_COUNTER_TYPE_U32=y
CONFIG_FREERTOS_RUN_TIME_STATS_USING_ESP_TIMER=y

CONFIG_UVC_TINYUSB_TASK_PRIORITY=10

CONFIG_UVC_CAM1_TASK_PRIORITY=9

# CONFIG_UVC_MODE_BULK_CAM1 is not set
```
