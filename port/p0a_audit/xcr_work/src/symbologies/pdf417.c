/*
 * PDF417 decoder (ISO/IEC 15438).
 *
 * No PDF417 codepath was found by string search in the decompiled reference
 * (docs/XCF_armeabi-v7a/libFsaDecoderCore1.c) since codeword text is not
 * present in that dump for this symbology, but a concrete GF(929) Reed-
 * Solomon implementation was located by its algorithmic signature:
 *
 *   - line ~13469  SmartSymbolRedef00024d[929]: a mod-929 multiplicative
 *     inverse table (verified: table[2]=465, 2*465=930=1 mod 929).
 *   - line ~70945  SmartSymbolRedef000244(codewords,n,maxCorrectable,out):
 *     GF(929) RS decoder. Primitive element alpha=3 ("v5 = 3*v5 mod 929"),
 *     negative codewords are treated as erasures on entry, syndromes,
 *     Berlekamp-Massey with erasure seeding, Chien search, Forney.
 *   - line ~70876  caller: builds maxCorrectable=(1<<(ecLevel+1))-2 and
 *     the pass/confidence formula transcribed verbatim in
 *     pdf417_rs_correct_and_score() below.
 *
 * The 700+ line RS body at line ~70945 is SSA-obfuscated decompiler output
 * (hundreds of renamed temporaries with no recoverable struct/variable
 * names) and transcribing it line-by-line would be unreliable. Instead
 * this file implements the mathematically equivalent, well-established
 * "errors-and-erasures" GF(929) Euclidean-algorithm RS decoder (same
 * field, same generator alpha=3, same erasure convention) and reuses the
 * *readable* wrapper's pass/confidence formulas verbatim. This mirrors how
 * datamatrix.c documents its own design-layer-extrapolated sections.
 *
 * The 3x929 codeword bar/space pattern table (ISO/IEC 15438 Annex table)
 * is public standard data with no code-string anchor in the decompiled
 * dump to literally transcribe; it is sourced here (and cross-checked
 * against the ISO structural invariants: 4 bars + 4 spaces summing to 17
 * modules, first element always a bar) from the open-source ZXing PDF417
 * decoder's PDF417Common.SYMBOL_TABLE / CODEWORD_TABLE, which is itself a
 * direct encoding of the published ISO/IEC 15438 Annex tables. Row
 * indicator codeword formulas, and Text/Byte/Numeric high-level decoding,
 * follow ISO/IEC 15438 5.4 as cross-checked against the same reference
 * decoder's DecodedBitStreamParser.
 *
 * Scope: single-pass row-raster scan (start/stop pattern search per image
 * row, no perspective correction) plus one whole-image horizontal-flip
 * retry for the *_mirror.bmp case. Sample images are clean, axis-aligned
 * synthetic renders, so this is sufficient; polarity inversion is already
 * handled by the caller's multipass (decode_core.c).
 */

#include "pdf417.h"
#include <stdint.h>
#include <stdlib.h>
#include <stdio.h>
#include <string.h>
#include <math.h>

/* ── Section 1: ISO/IEC 15438 codeword pattern tables ────────────────────
 * PDF417_SYMBOL_TABLE: sorted ascending, each entry is the 17-bit MSB-first
 * bar/space pattern of one of the 2787 (3 clusters x 929) symbol
 * characters (bit=1 -> bar/dark module, first module always a bar).
 * PDF417_CODEWORD_TABLE[i] = cluster*929 + codeword_value + 1, indexed in
 * lockstep with PDF417_SYMBOL_TABLE (binary-search on the symbol table,
 * then decode via this table -- same scheme as the reference decoder).
 */
static const uint32_t PDF417_SYMBOL_TABLE[2787] = {
    66142, 66170, 66206, 66236, 66290, 66292, 66350, 66382, 66396, 66454, 66470, 66476, 66594, 66600,
    66614, 66626, 66628, 66632, 66640, 66654, 66662, 66668, 66682, 66690, 66718, 66720, 66748, 66758,
    66776, 66798, 66802, 66804, 66820, 66824, 66832, 66846, 66848, 66876, 66880, 66936, 66950, 66956,
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    130010,
};

static const uint16_t PDF417_CODEWORD_TABLE[2787] = {
    2627, 1819, 2622, 2621, 1813, 1812, 2729, 2724, 2723, 2779, 2774, 2773, 902, 896,
    908, 868, 865, 861, 859, 2511, 873, 871, 1780, 835, 2493, 825, 2491, 842,
    837, 844, 1764, 1762, 811, 810, 809, 2483, 807, 2482, 806, 2480, 815, 814,
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    1700,
};

/* ── Section 2: GF(929) arithmetic (generator alpha = 3) ─────────────────
 * Faithful to the reference's field (mod 929, alpha=3 per the decompiled
 * "v5 = 3*v5 mod 929" walk at line ~70945).
 */
#define PDF417_GF_MOD 929

typedef struct {
    int exp_table[PDF417_GF_MOD];      /* exp_table[i] = alpha^i mod 929 */
    int log_table[PDF417_GF_MOD];      /* log_table[alpha^i] = i         */
} Pdf417Gf;

static void pdf417_gf_init(Pdf417Gf *gf)
{
    int x = 1;
    for (int i = 0; i < PDF417_GF_MOD; i++) {
        gf->exp_table[i] = x;
        x = (x * 3) % PDF417_GF_MOD;
    }
    memset(gf->log_table, 0, sizeof(gf->log_table));
    for (int i = 0; i < PDF417_GF_MOD - 1; i++) {
        gf->log_table[gf->exp_table[i]] = i;
    }
}

static inline int pdf417_gf_add(int a, int b) { return (a + b) % PDF417_GF_MOD; }
static inline int pdf417_gf_sub(int a, int b) { return (PDF417_GF_MOD + a - b) % PDF417_GF_MOD; }
static inline int pdf417_gf_mul(const Pdf417Gf *gf, int a, int b)
{
    if (a == 0 || b == 0) return 0;
    return gf->exp_table[(gf->log_table[a] + gf->log_table[b]) % (PDF417_GF_MOD - 1)];
}
static inline int pdf417_gf_inv(const Pdf417Gf *gf, int a)
{
    /* a != 0 guaranteed by all call sites */
    return gf->exp_table[PDF417_GF_MOD - 1 - gf->log_table[a]];
}

/* ── Section 3: GF(929) polynomial helpers (ascending: coef[0] = x^0) ───
 * Errors-and-erasures Reed-Solomon decode via the extended Euclidean
 * algorithm, generalizing the classic error-only construction (see e.g.
 * ZXing's ErrorCorrection/ModulusGF/ModulusPoly, which implement the same
 * GF(929, alpha=3) field but only the error-only special case) to also
 * seed the erasure locator, per standard errors-and-erasures RS decoding.
 */
#define PDF417_MAX_CW   929
#define PDF417_MAX_EC   512
#define PDF417_MAX_POLY (PDF417_MAX_CW + PDF417_MAX_EC + 4)

typedef struct {
    int c[PDF417_MAX_POLY];
    int len; /* degree = len-1; len==0 means the zero polynomial */
} Pdf417Poly;

static void poly_trim(Pdf417Poly *p)
{
    while (p->len > 1 && p->c[p->len - 1] == 0) p->len--;
    if (p->len == 1 && p->c[0] == 0) { /* keep as [0] (zero poly) */ }
}

static int poly_degree(const Pdf417Poly *p) { return p->len - 1; }
static int poly_is_zero(const Pdf417Poly *p) { return p->len == 1 && p->c[0] == 0; }

static int poly_eval_at(const Pdf417Poly *p, int x)
{
    if (x == 0) return p->c[0];
    int result = p->c[p->len - 1];
    for (int i = p->len - 2; i >= 0; i--) {
        result = (result * x + p->c[i]) % PDF417_GF_MOD;
    }
    return result;
}

static void poly_mul(const Pdf417Poly *a, const Pdf417Poly *b, Pdf417Poly *out)
{
    if (poly_is_zero(a) || poly_is_zero(b)) { out->c[0] = 0; out->len = 1; return; }
    int la = a->len, lb = b->len;
    int lc = la + lb - 1;
    int tmp[PDF417_MAX_POLY];
    memset(tmp, 0, sizeof(int) * (size_t)lc);
    for (int i = 0; i < la; i++) {
        if (a->c[i] == 0) continue;
        for (int j = 0; j < lb; j++) {
            if (b->c[j] == 0) continue;
            tmp[i + j] = (tmp[i + j] + a->c[i] * b->c[j]) % PDF417_GF_MOD;
        }
    }
    memcpy(out->c, tmp, sizeof(int) * (size_t)lc);
    out->len = lc;
    poly_trim(out);
}

/* out = a - b*monomial(shift)*scale, truncated to a's stored length */
static void poly_sub_scaled_shifted(Pdf417Poly *a, const Pdf417Poly *b, int shift, int scale)
{
    if (scale == 0) return;
    int need = b->len + shift;
    if (need > a->len) {
        for (int i = a->len; i < need; i++) a->c[i] = 0;
        a->len = need;
    }
    for (int j = 0; j < b->len; j++) {
        if (b->c[j] == 0) continue;
        int idx = j + shift;
        a->c[idx] = pdf417_gf_sub(a->c[idx], (b->c[j] * scale) % PDF417_GF_MOD);
    }
    poly_trim(a);
}

static void poly_truncate(Pdf417Poly *p, int max_len)
{
    if (p->len > max_len) p->len = max_len > 0 ? max_len : 1;
    poly_trim(p);
}

static void poly_scale(Pdf417Poly *p, int scale)
{
    for (int i = 0; i < p->len; i++) p->c[i] = (p->c[i] * scale) % PDF417_GF_MOD;
}

/* Formal derivative: d/dx of ascending-coefficient poly */
static void poly_derivative(const Pdf417Poly *p, Pdf417Poly *out)
{
    int deg = poly_degree(p);
    if (deg <= 0) { out->c[0] = 0; out->len = 1; return; }
    for (int i = 1; i <= deg; i++) {
        out->c[i - 1] = (i % PDF417_GF_MOD) * p->c[i] % PDF417_GF_MOD;
    }
    out->len = deg;
    poly_trim(out);
}


/* ── Section 4: errors-and-erasures RS decode ────────────────────────────
 * received[]: recv_len codewords, received[0] = first (highest-degree,
 * data) codeword ... received[recv_len-1] = last (lowest-degree, EC)
 * codeword -- the standard ISO/IEC 15438 systematic ordering (data then
 * EC), corrected in place. erasure_pos[]: indices (into received[]) of
 * codewords that were unreadable (marked -1 by the caller and zeroed
 * here before calling). Returns 0 on success with *out_total_corrected
 * set to (erasures + true errors) found, -1 if uncorrectable.
 */
static int pdf417_rs_decode(int *received, int recv_len, int num_ec,
                             const int *erasure_pos, int n_erasures,
                             int *out_total_corrected)
{
    if (recv_len <= 0 || recv_len > PDF417_MAX_CW || num_ec <= 0 || num_ec > PDF417_MAX_EC) return -1;
    if (n_erasures > num_ec || recv_len <= num_ec) return -1;

    Pdf417Gf gf;
    pdf417_gf_init(&gf);

    Pdf417Poly R;
    for (int k = 0; k < recv_len; k++) R.c[k] = received[recv_len - 1 - k];
    R.len = recv_len;
    poly_trim(&R);

    Pdf417Poly S;
    int any_nonzero = 0;
    for (int j = 0; j < num_ec; j++) {
        int val = poly_eval_at(&R, gf.exp_table[j + 1]);
        S.c[j] = val;
        if (val != 0) any_nonzero = 1;
    }
    S.len = num_ec;
    poly_trim(&S);

    if (!any_nonzero) {
        if (n_erasures > 0) return -1; /* erasures claimed but no discrepancy: inconsistent */
        if (out_total_corrected) *out_total_corrected = 0;
        return 0;
    }

    Pdf417Poly lambda0;
    lambda0.c[0] = 1; lambda0.len = 1;
    for (int i = 0; i < n_erasures; i++) {
        int pos = erasure_pos[i];
        if (pos < 0 || pos >= recv_len) return -1;
        int Xk = gf.exp_table[recv_len - 1 - pos];
        Pdf417Poly term, tmp;
        term.c[0] = 1;
        term.c[1] = pdf417_gf_sub(0, Xk);
        term.len = 2;
        poly_mul(&lambda0, &term, &tmp);
        lambda0 = tmp;
    }

    Pdf417Poly T;
    poly_mul(&S, &lambda0, &T);
    poly_truncate(&T, num_ec);

    Pdf417Poly a, r_last, r_cur, t_last, t_cur;
    memset(a.c, 0, sizeof(int) * (size_t)(num_ec + 1));
    a.c[num_ec] = 1; a.len = num_ec + 1;
    r_last = a;
    r_cur = T;
    t_last.c[0] = 0; t_last.len = 1;
    t_cur.c[0] = 1; t_cur.len = 1;

    int stop_deg = (num_ec + n_erasures) / 2;
    int iterations = 0;
    while (poly_degree(&r_cur) >= stop_deg) {
        if (++iterations > 2 * PDF417_MAX_EC + 8) return -1;
        if (poly_is_zero(&r_cur)) return -1;

        Pdf417Poly r_prev_prev = r_last;
        Pdf417Poly t_prev_prev = t_last;
        r_last = r_cur;
        t_last = t_cur;

        Pdf417Poly r = r_prev_prev;
        Pdf417Poly q;
        q.c[0] = 0; q.len = 1;
        int lead_inv = pdf417_gf_inv(&gf, r_last.c[r_last.len - 1]);
        while (poly_degree(&r) >= poly_degree(&r_last) && !poly_is_zero(&r)) {
            int deg_diff = poly_degree(&r) - poly_degree(&r_last);
            int scale = pdf417_gf_mul(&gf, r.c[r.len - 1], lead_inv);
            if (deg_diff + 1 > q.len) {
                for (int i = q.len; i < deg_diff + 1; i++) q.c[i] = 0;
                q.len = deg_diff + 1;
            }
            q.c[deg_diff] = pdf417_gf_add(q.c[deg_diff], scale);
            poly_sub_scaled_shifted(&r, &r_last, deg_diff, scale);
        }
        r_cur = r;

        Pdf417Poly qt;
        poly_mul(&q, &t_last, &qt);
        int max_len = qt.len > t_prev_prev.len ? qt.len : t_prev_prev.len;
        Pdf417Poly tnew;
        for (int i = 0; i < max_len; i++) {
            int av = i < qt.len ? qt.c[i] : 0;
            int bv = i < t_prev_prev.len ? t_prev_prev.c[i] : 0;
            tnew.c[i] = pdf417_gf_sub(av, bv);
        }
        tnew.len = max_len;
        poly_trim(&tnew);
        t_cur = tnew;
    }

    int sigma0 = t_cur.c[0];
    if (sigma0 == 0) return -1;
    int inv0 = pdf417_gf_inv(&gf, sigma0);
    poly_scale(&t_cur, inv0);
    poly_scale(&r_cur, inv0);

    Pdf417Poly lambda, omega;
    poly_mul(&t_cur, &lambda0, &lambda);
    omega = r_cur;

    int lambda_deg = poly_degree(&lambda);
    if (lambda_deg <= 0 && n_erasures == 0) return -1;

    int locations[PDF417_MAX_EC];
    int n_loc = 0;
    for (int i = 1; i < PDF417_GF_MOD && n_loc < lambda_deg && n_loc < PDF417_MAX_EC; i++) {
        if (poly_eval_at(&lambda, i) == 0) {
            locations[n_loc++] = i;
        }
    }
    if (n_loc != lambda_deg) return -1;

    Pdf417Poly lambda_deriv;
    poly_derivative(&lambda, &lambda_deriv);

    for (int i = 0; i < n_loc; i++) {
        int xi_inv = locations[i];
        int Xk = pdf417_gf_inv(&gf, xi_inv);
        int position = recv_len - 1 - gf.log_table[Xk];
        if (position < 0 || position >= recv_len) return -1;
        int omega_val = poly_eval_at(&omega, xi_inv);
        int deriv_val = poly_eval_at(&lambda_deriv, xi_inv);
        if (deriv_val == 0) return -1;
        int numerator = pdf417_gf_sub(0, omega_val);
        int magnitude = pdf417_gf_mul(&gf, numerator, pdf417_gf_inv(&gf, deriv_val));
        received[position] = pdf417_gf_sub(received[position], magnitude);
    }

    if (out_total_corrected) *out_total_corrected = n_loc;
    return 0;
}

/* Pass/confidence formula transcribed verbatim from the decompiled
 * reference's caller (line ~70876-70943): maxCorrectable = ecCount-2 by
 * default, ecCount-3 if errors<4, restored to ecCount-2 when ecCount==2;
 * pass iff erasures+2*errors <= threshold; confidence scales linearly.
 * Split out as an _ex variant taking num_ec directly (rather than deriving
 * it from a power-of-two ec_level) so the MicroPDF417 / GS1 Composite CC-A
 * decoder can reuse the same formula with its own (non power-of-two) EC
 * counts from the ISO/IEC 24728 variant tables. */
static int pdf417_rs_correct_and_score_ex(int *codewords, int total_len, int num_ec,
                                           const int *erasure_pos, int n_erasures,
                                           int *out_confidence)
{
    if (num_ec <= 0 || num_ec >= total_len) return 0;

    int total_corrected = 0;
    if (pdf417_rs_decode(codewords, total_len, num_ec, erasure_pos, n_erasures, &total_corrected) != 0) {
        return 0;
    }
    int erasures = n_erasures;
    int errors = total_corrected - erasures;
    if (errors < 0) return 0;

    int ec_count = num_ec;
    int threshold = ec_count - 2;
    if (errors < 4) threshold = ec_count - 3;
    if (ec_count == 2) threshold = ec_count - 2;
    int check_val = erasures + 2 * errors;
    if (check_val > threshold) return 0;
    if (out_confidence) {
        int conf = 100 - 100 * check_val / (threshold + 1);
        if (conf < 0) conf = 0;
        if (conf > 100) conf = 100;
        *out_confidence = conf;
    }
    return 1;
}

static int pdf417_rs_correct_and_score(int *codewords, int total_len, int ec_level,
                                        const int *erasure_pos, int n_erasures,
                                        int *out_confidence)
{
    if (ec_level < 0 || ec_level > 8) return 0;
    int num_ec = 1 << (ec_level + 1);
    return pdf417_rs_correct_and_score_ex(codewords, total_len, num_ec,
                                           erasure_pos, n_erasures, out_confidence);
}

/* ── Section 5: image binarization + row raster scan ──────────────────── */

#define PDF417_MAX_COLS  30
#define PDF417_MAX_ROWS  90
#define PDF417_MAX_RUNS  2048

static int pdf417_otsu_threshold(const Image *img)
{
    long hist[256];
    memset(hist, 0, sizeof(hist));
    size_t n = (size_t)img->width * (size_t)img->height;
    for (size_t i = 0; i < n; i++) hist[img->pixels[i]]++;

    double sum = 0.0;
    for (int t = 0; t < 256; t++) sum += (double)t * (double)hist[t];

    double sumB = 0.0;
    long wB = 0;
    double max_var = -1.0;
    int thresh = 127;
    for (int t = 0; t < 256; t++) {
        wB += hist[t];
        if (wB == 0) continue;
        long wF = (long)n - wB;
        if (wF == 0) break;
        sumB += (double)t * (double)hist[t];
        double mB = sumB / (double)wB;
        double mF = (sum - sumB) / (double)wF;
        double diff = mB - mF;
        double var_between = (double)wB * (double)wF * diff * diff;
        if (var_between > max_var) {
            max_var = var_between;
            thresh = t;
        }
    }
    return thresh;
}

typedef struct { int w; int dark; } Pdf417Run;

static int pdf417_extract_runs(const Image *img, int y, int thresh, Pdf417Run *runs, int max_runs)
{
    int W = img->width;
    const uint8_t *row = img->pixels + (size_t)y * (size_t)W;
    int n = 0;
    int cur_dark = row[0] < thresh;
    int run_len = 1;
    for (int x = 1; x < W; x++) {
        int d = row[x] < thresh;
        if (d == cur_dark) {
            run_len++;
        } else {
            if (n < max_runs) { runs[n].w = run_len; runs[n].dark = cur_dark; n++; }
            cur_dark = d;
            run_len = 1;
        }
    }
    if (n < max_runs) { runs[n].w = run_len; runs[n].dark = cur_dark; n++; }
    return n;
}

static const int PDF417_START_PATTERN[8] = { 8, 1, 1, 1, 1, 1, 1, 3 };
static const int PDF417_STOP_PATTERN[9]  = { 7, 1, 1, 3, 1, 1, 1, 2, 1 };

static int pdf417_match_guard(const Pdf417Run *runs, int idx, const int *pattern, int plen, double tol)
{
    if (!runs[idx].dark) return 0;
    int sum = 0, psum = 0;
    for (int k = 0; k < plen; k++) { sum += runs[idx + k].w; psum += pattern[k]; }
    if (sum <= 0) return 0;
    double m = (double)sum / (double)psum;
    if (m < 0.4) return 0;
    for (int k = 0; k < plen; k++) {
        double diff = (double)runs[idx + k].w / m - (double)pattern[k];
        if (diff < 0) diff = -diff;
        if (diff > tol) return 0;
    }
    return 1;
}

/* zxing PDF417CodewordDecoder.sampleBitCounts: redistribute raw pixel run
 * widths (8 bar/space runs) into exactly 17 module counts. */
static void pdf417_sample_bit_counts(const int *run_w, int sum, int *out8)
{
    memset(out8, 0, sizeof(int) * 8);
    int bit_idx = 0, sum_prev = 0;
    for (int i = 0; i < 17; i++) {
        double sample_index = (double)sum / (2.0 * 17.0) + ((double)i * (double)sum) / 17.0;
        if (bit_idx < 7 && sum_prev + run_w[bit_idx] <= sample_index) {
            sum_prev += run_w[bit_idx];
            bit_idx++;
        }
        out8[bit_idx]++;
    }
}

/* Binary search PDF417_SYMBOL_TABLE for a 17-bit bar/space pattern value.
 * Returns codeword value 0..928 and cluster 0..2, or -1 on miss. Shared by
 * pdf417_match_symbol (pixel-run based, full PDF417) and the MicroPDF417 /
 * GS1 Composite CC-A row decoder (direct module-bit based, see Section 9). */
static int pdf417_symbol_table_lookup(uint32_t val, int *out_cluster)
{
    int lo = 0, hi = 2786;
    while (lo <= hi) {
        int mid = (lo + hi) / 2;
        uint32_t mv = PDF417_SYMBOL_TABLE[mid];
        if (mv == val) {
            int cwv = (int)PDF417_CODEWORD_TABLE[mid] - 1;
            *out_cluster = cwv / 929;
            return cwv % 929;
        } else if (mv < val) {
            lo = mid + 1;
        } else {
            hi = mid - 1;
        }
    }
    return -1;
}

/* Binary search PDF417_SYMBOL_TABLE for the codeword's 17-bit pattern.
 * Returns codeword value 0..928 and cluster 0..2, or -1 on miss (treated
 * as an erasure by the caller, per design: "查不到记-1"). */
static int pdf417_match_symbol(const int *run_w8, int *out_cluster)
{
    int sum = 0;
    for (int i = 0; i < 8; i++) sum += run_w8[i];
    if (sum <= 0) return -1;
    int modcount[8];
    pdf417_sample_bit_counts(run_w8, sum, modcount);

    uint32_t val = 0;
    for (int i = 0; i < 8; i++) {
        int bit = (i % 2 == 0) ? 1 : 0;
        for (int b = 0; b < modcount[i]; b++) val = (val << 1) | (uint32_t)bit;
    }

    return pdf417_symbol_table_lookup(val, out_cluster);
}

typedef struct {
    int row;
    int cluster;
    int n_cw;
    int cw[PDF417_MAX_COLS + 2];
    int val_L, val_R;
} Pdf417ScanLine;

static int pdf417_argmax(const int *votes, int n)
{
    int best = 0;
    for (int i = 1; i < n; i++) if (votes[i] > votes[best]) best = i;
    return best;
}

static int pdf417_scan_row(const Image *img, int y, int thresh, Pdf417ScanLine *line)
{
    static Pdf417Run runs[PDF417_MAX_RUNS];
    int n = pdf417_extract_runs(img, y, thresh, runs, PDF417_MAX_RUNS);
    if (n < 8 + 9) return 0;

    int start_idx = -1;
    for (int i = 0; i + 8 <= n; i++) {
        if (pdf417_match_guard(runs, i, PDF417_START_PATTERN, 8, 0.62)) { start_idx = i; break; }
    }
    if (start_idx < 0) return 0;

    int cw_begin = start_idx + 8;
    int stop_idx = -1;
    for (int i = cw_begin; i + 9 <= n; i++) {
        if (pdf417_match_guard(runs, i, PDF417_STOP_PATTERN, 9, 0.62)) { stop_idx = i; }
    }
    if (stop_idx < 0) return 0;

    int nruns = stop_idx - cw_begin;
    if (nruns <= 0 || nruns % 8 != 0) return 0;
    int n_cw = nruns / 8;
    if (n_cw < 3 || n_cw > PDF417_MAX_COLS + 2) return 0;

    line->n_cw = n_cw;
    int cluster_votes[3] = { 0, 0, 0 };
    int val_first = -1, val_last = -1, clu_first = -1, clu_last = -1;
    for (int j = 0; j < n_cw; j++) {
        int rw[8];
        for (int k = 0; k < 8; k++) rw[k] = runs[cw_begin + j * 8 + k].w;
        int clu = -1;
        int v = pdf417_match_symbol(rw, &clu);
        line->cw[j] = v;
        if (v >= 0) {
            cluster_votes[clu]++;
            if (j == 0) { val_first = v; clu_first = clu; }
            if (j == n_cw - 1) { val_last = v; clu_last = clu; }
        }
    }
    (void)clu_first; (void)clu_last;
    if (cluster_votes[0] + cluster_votes[1] + cluster_votes[2] == 0) return 0;
    int line_cluster = pdf417_argmax(cluster_votes, 3);

    int row = -1;
    if (val_first >= 0) row = (val_first / 30) * 3 + line_cluster;
    else if (val_last >= 0) row = (val_last / 30) * 3 + line_cluster;
    if (row < 0 || row >= PDF417_MAX_ROWS) return 0;

    line->row = row;
    line->cluster = line_cluster;
    line->val_L = val_first;
    line->val_R = val_last;
    return 1;
}


/* ── Section 6: row indicator voting + data matrix assembly ─────────────
 * Row indicator codeword value V = 30*floor(row/3) + X. Which quantity X
 * encodes depends on (isLeft, row%3) per ISO/IEC 15438 5.2.3 / the classic
 * "US Patent 5,243,655" row-indicator table (cross-checked against
 * ZXing's DetectionResultRowIndicatorColumn.adjustCompleteIndicatorColumn):
 *   cluster0: left X=(rows-1)/3            right X=cols-1
 *   cluster1: left X=ecLevel*3+(rows-1)%3  right X=(rows-1)/3
 *   cluster2: left X=cols-1                right X=ecLevel*3+(rows-1)%3
 */
static void pdf417_cast_ri_vote(int is_left, int cluster, int X,
                                 int *rows_upper_votes, int *cols_votes,
                                 int *ec_votes, int *rows_lower_votes)
{
    int role; /* 0 = rows_upper, 1 = cols, 2 = ec+rows_lower */
    if (cluster == 0) role = is_left ? 0 : 1;
    else if (cluster == 1) role = is_left ? 2 : 0;
    else role = is_left ? 1 : 2;

    switch (role) {
        case 0:
            if (X >= 0 && X < PDF417_MAX_ROWS) rows_upper_votes[X]++;
            break;
        case 1:
            if (X >= 0 && X + 1 <= PDF417_MAX_COLS) cols_votes[X + 1]++;
            break;
        case 2: {
            int ec = X / 3, rl = X % 3;
            if (ec >= 0 && ec <= 8) ec_votes[ec]++;
            if (rl >= 0 && rl < 3) rows_lower_votes[rl]++;
            break;
        }
    }
}

typedef struct {
    int rows, cols, ec_level;
    int *codewords;   /* rows*cols, -1 = erasure */
} Pdf417Matrix;

static int pdf417_locate_and_decode_matrix(const Image *img, Pdf417Matrix *out)
{
    int thresh = pdf417_otsu_threshold(img);
    int H = img->height;

    Pdf417ScanLine *lines = (Pdf417ScanLine *)malloc(sizeof(Pdf417ScanLine) * (size_t)H);
    if (!lines) return 0;
    int n_lines = 0;

    int rows_upper_votes[PDF417_MAX_ROWS];
    int cols_votes[PDF417_MAX_COLS + 1];
    int ec_votes[9];
    int rows_lower_votes[3];
    memset(rows_upper_votes, 0, sizeof(rows_upper_votes));
    memset(cols_votes, 0, sizeof(cols_votes));
    memset(ec_votes, 0, sizeof(ec_votes));
    memset(rows_lower_votes, 0, sizeof(rows_lower_votes));

    for (int y = 0; y < H; y++) {
        Pdf417ScanLine line;
        if (!pdf417_scan_row(img, y, thresh, &line)) continue;
        lines[n_lines++] = line;

        if (line.val_L >= 0) {
            int X = line.val_L % 30;
            pdf417_cast_ri_vote(1, line.cluster, X, rows_upper_votes, cols_votes, ec_votes, rows_lower_votes);
        }
        if (line.val_R >= 0) {
            int X = line.val_R % 30;
            pdf417_cast_ri_vote(0, line.cluster, X, rows_upper_votes, cols_votes, ec_votes, rows_lower_votes);
        }
    }

    if (n_lines == 0) { free(lines); return 0; }

    int rows_upper = pdf417_argmax(rows_upper_votes, PDF417_MAX_ROWS);
    int rows_lower = pdf417_argmax(rows_lower_votes, 3);
    int ec_level = pdf417_argmax(ec_votes, 9);
    int cols_idx = 0;
    for (int i = 1; i <= PDF417_MAX_COLS; i++) if (cols_votes[i] > cols_votes[cols_idx]) cols_idx = i;
    int cols = cols_idx;
    int rows = rows_upper * 3 + rows_lower + 1;

    if (cols < 1 || cols > PDF417_MAX_COLS || rows < 1 || rows > PDF417_MAX_ROWS ||
        cols_votes[cols] == 0 || (rows_upper_votes[rows_upper] == 0 && rows_lower_votes[rows_lower] == 0)) {
        free(lines);
        return 0;
    }

    int total = rows * cols;
    int *mval = (int *)calloc((size_t)total, sizeof(int));
    int *mcnt = (int *)calloc((size_t)total, sizeof(int));
    if (!mval || !mcnt) { free(lines); free(mval); free(mcnt); return 0; }

    int expected_cw = cols + 2;
    for (int i = 0; i < n_lines; i++) {
        Pdf417ScanLine *line = &lines[i];
        if (line->row >= rows || line->n_cw != expected_cw) continue;
        for (int c = 0; c < cols; c++) {
            int v = line->cw[c + 1];
            if (v < 0) continue;
            int idx = line->row * cols + c;
            if (mcnt[idx] == 0) { mval[idx] = v; mcnt[idx] = 1; }
            else if (mval[idx] == v) { mcnt[idx]++; }
            else { mcnt[idx]--; }
        }
    }

    int *codewords = (int *)malloc(sizeof(int) * (size_t)total);
    if (!codewords) { free(lines); free(mval); free(mcnt); return 0; }
    for (int i = 0; i < total; i++) codewords[i] = (mcnt[i] > 0) ? mval[i] : -1;

    free(lines);
    free(mval);
    free(mcnt);

    out->rows = rows;
    out->cols = cols;
    out->ec_level = ec_level;
    out->codewords = codewords;
    return 1;
}


/* ── Section 7: high-level text decode (ISO/IEC 15438 5.4) ──────────────
 * Mode-latch codewords and sub-mode tables cross-checked against ZXing's
 * DecodedBitStreamParser (same public ISO/IEC 15438 5.4 tables).
 */
#define PDF417_TEXT_LATCH   900
#define PDF417_BYTE_LATCH   901
#define PDF417_NUMERIC_LATCH 902
#define PDF417_BYTE_LATCH_6 924
#define PDF417_ECI_USER     925
#define PDF417_ECI_GENERAL  926
#define PDF417_ECI_CHARSET  927
#define PDF417_MACRO_BEGIN  928
#define PDF417_MACRO_OPT    923
#define PDF417_MACRO_END    922
#define PDF417_READER_INIT  921
#define PDF417_SHIFT_BYTE   913

#define PDF417_PL 25
#define PDF417_LL 27
#define PDF417_AS 27
#define PDF417_ML 28
#define PDF417_AL 28
#define PDF417_PS 29
#define PDF417_PAL 29

static const char PDF417_PUNCT_CHARS[29] = { ';','<','>','@','[','\\',']','_','`','~','!','\r','\t',
    ',',':','\n','-','.','$','/','"','|','*','(',')','?','{','}','\'' };
static const char PDF417_MIXED_CHARS[26] = { '0','1','2','3','4','5','6','7','8','9','&','\r','\t',
    ',',':','#','-','.','$','/','+','%','*','=','^' };

typedef struct {
    char *buf;
    int len;
    int cap;
} Pdf417Out;

static void pdf417_out_putc(Pdf417Out *o, char c)
{
    if (o->len < o->cap - 1) { o->buf[o->len++] = c; o->buf[o->len] = '\0'; }
}
static void pdf417_out_putbyte(Pdf417Out *o, unsigned char c)
{
    pdf417_out_putc(o, (char)c);
}

typedef enum { PDF_ALPHA, PDF_LOWER, PDF_MIXED, PDF_PUNCT, PDF_ALPHA_SHIFT, PDF_PUNCT_SHIFT } Pdf417TextMode;

static Pdf417TextMode pdf417_decode_text_sub(const int *tcd, const int *bcd, int length,
                                              Pdf417Out *out, Pdf417TextMode start_mode)
{
    Pdf417TextMode sub_mode = start_mode;
    Pdf417TextMode prior_mode = start_mode;
    Pdf417TextMode latched_mode = start_mode;

    for (int i = 0; i < length; i++) {
        int sc = tcd[i];
        char ch = 0;
        switch (sub_mode) {
        case PDF_ALPHA:
            if (sc < 26) ch = (char)('A' + sc);
            else if (sc == 26) ch = ' ';
            else if (sc == PDF417_LL) { sub_mode = PDF_LOWER; latched_mode = sub_mode; }
            else if (sc == PDF417_ML) { sub_mode = PDF_MIXED; latched_mode = sub_mode; }
            else if (sc == PDF417_PS) { prior_mode = sub_mode; sub_mode = PDF_PUNCT_SHIFT; }
            else if (sc == PDF417_SHIFT_BYTE) { pdf417_out_putbyte(out, (unsigned char)bcd[i]); }
            else if (sc == PDF417_TEXT_LATCH) { sub_mode = PDF_ALPHA; latched_mode = sub_mode; }
            break;
        case PDF_LOWER:
            if (sc < 26) ch = (char)('a' + sc);
            else if (sc == 26) ch = ' ';
            else if (sc == PDF417_AS) { prior_mode = sub_mode; sub_mode = PDF_ALPHA_SHIFT; }
            else if (sc == PDF417_ML) { sub_mode = PDF_MIXED; latched_mode = sub_mode; }
            else if (sc == PDF417_PS) { prior_mode = sub_mode; sub_mode = PDF_PUNCT_SHIFT; }
            else if (sc == PDF417_SHIFT_BYTE) { pdf417_out_putbyte(out, (unsigned char)bcd[i]); }
            else if (sc == PDF417_TEXT_LATCH) { sub_mode = PDF_ALPHA; latched_mode = sub_mode; }
            break;
        case PDF_MIXED:
            if (sc < PDF417_PL) ch = PDF417_MIXED_CHARS[sc];
            else if (sc == PDF417_PL) { sub_mode = PDF_PUNCT; latched_mode = sub_mode; }
            else if (sc == 26) ch = ' ';
            else if (sc == PDF417_LL) { sub_mode = PDF_LOWER; latched_mode = sub_mode; }
            else if (sc == PDF417_AL || sc == PDF417_TEXT_LATCH) { sub_mode = PDF_ALPHA; latched_mode = sub_mode; }
            else if (sc == PDF417_PS) { prior_mode = sub_mode; sub_mode = PDF_PUNCT_SHIFT; }
            else if (sc == PDF417_SHIFT_BYTE) { pdf417_out_putbyte(out, (unsigned char)bcd[i]); }
            break;
        case PDF_PUNCT:
            if (sc < PDF417_PAL) ch = PDF417_PUNCT_CHARS[sc];
            else if (sc == PDF417_PAL || sc == PDF417_TEXT_LATCH) { sub_mode = PDF_ALPHA; latched_mode = sub_mode; }
            else if (sc == PDF417_SHIFT_BYTE) { pdf417_out_putbyte(out, (unsigned char)bcd[i]); }
            break;
        case PDF_ALPHA_SHIFT:
            sub_mode = prior_mode;
            if (sc < 26) ch = (char)('A' + sc);
            else if (sc == 26) ch = ' ';
            else if (sc == PDF417_TEXT_LATCH) { sub_mode = PDF_ALPHA; }
            break;
        case PDF_PUNCT_SHIFT:
            sub_mode = prior_mode;
            if (sc < PDF417_PAL) ch = PDF417_PUNCT_CHARS[sc];
            else if (sc == PDF417_PAL || sc == PDF417_TEXT_LATCH) { sub_mode = PDF_ALPHA; }
            else if (sc == PDF417_SHIFT_BYTE) { pdf417_out_putbyte(out, (unsigned char)bcd[i]); }
            break;
        }
        if (ch != 0) pdf417_out_putc(out, ch);
    }
    return latched_mode;
}

static int pdf417_text_compaction(const int *cw, int count, int idx, Pdf417Out *out)
{
    int cap = (count - idx) * 2;
    if (cap < 2) cap = 2;
    int *tcd = (int *)malloc(sizeof(int) * (size_t)cap);
    int *bcd = (int *)malloc(sizeof(int) * (size_t)cap);
    if (!tcd || !bcd) { free(tcd); free(bcd); return count; }

    int index = 0;
    int end = 0;
    Pdf417TextMode sub_mode = PDF_ALPHA;

    while (idx < count && !end) {
        int code = cw[idx++];
        if (code < PDF417_TEXT_LATCH) {
            tcd[index] = code / 30;
            tcd[index + 1] = code % 30;
            index += 2;
        } else {
            switch (code) {
            case PDF417_TEXT_LATCH:
                tcd[index++] = PDF417_TEXT_LATCH;
                break;
            case PDF417_BYTE_LATCH:
            case PDF417_BYTE_LATCH_6:
            case PDF417_NUMERIC_LATCH:
            case PDF417_MACRO_BEGIN:
            case PDF417_MACRO_OPT:
            case PDF417_MACRO_END:
                idx--;
                end = 1;
                break;
            case PDF417_SHIFT_BYTE:
                tcd[index] = PDF417_SHIFT_BYTE;
                if (idx >= count) { end = 1; break; }
                bcd[index] = cw[idx++];
                index++;
                break;
            case PDF417_ECI_CHARSET:
                if (idx >= count) { end = 1; break; }
                idx++; /* skip ECI designator, unsupported */
                break;
            default:
                break;
            }
        }
    }
    pdf417_decode_text_sub(tcd, bcd, index, out, sub_mode);
    free(tcd);
    free(bcd);
    return idx;
}

static int pdf417_byte_compaction(int mode, const int *cw, int count, int idx, Pdf417Out *out)
{
    int end = 0;
    while (idx < count && !end) {
        if (idx >= count || cw[idx] >= PDF417_TEXT_LATCH) { end = 1; break; }
        uint64_t value = 0;
        int n = 0;
        do {
            value = value * 900u + (uint64_t)cw[idx++];
            n++;
        } while (n < 5 && idx < count && cw[idx] < PDF417_TEXT_LATCH);

        if (n == 5 && (mode == PDF417_BYTE_LATCH_6 || (idx < count && cw[idx] < PDF417_TEXT_LATCH))) {
            for (int i = 0; i < 6; i++) {
                pdf417_out_putbyte(out, (unsigned char)(value >> (8 * (5 - i))));
            }
        } else {
            idx -= n;
            while (idx < count && !end) {
                int code = cw[idx++];
                if (code < PDF417_TEXT_LATCH) {
                    pdf417_out_putbyte(out, (unsigned char)code);
                } else {
                    idx--;
                    end = 1;
                }
            }
        }
    }
    return idx;
}

#define PDF417_BIGNUM_MAX 80
static void pdf417_bignum_muladd(unsigned char *digits, int *ndigits, int mul, int add)
{
    int carry = add;
    for (int i = 0; i < *ndigits; i++) {
        int v = digits[i] * mul + carry;
        digits[i] = (unsigned char)(v % 10);
        carry = v / 10;
    }
    while (carry > 0 && *ndigits < PDF417_BIGNUM_MAX) {
        digits[*ndigits] = (unsigned char)(carry % 10);
        carry /= 10;
        (*ndigits)++;
    }
}

/* Base-900 -> base-10 bignum conversion (ISO/IEC 15438 5.4.4). codewords[]
 * hold `n` base-900 digits, MSB first; result is prefixed with an
 * artificial leading '1' which is stripped, per spec. */
static void pdf417_numeric_to_string(const int *codewords, int n, Pdf417Out *out)
{
    unsigned char digits[PDF417_BIGNUM_MAX];
    int ndigits = 1;
    digits[0] = 1;
    for (int i = 0; i < n; i++) {
        pdf417_bignum_muladd(digits, &ndigits, 900, codewords[i]);
    }
    /* digits[] is little-endian; most significant digit is digits[ndigits-1],
     * expected to be the artificial '1' prefix -- skip it on output. */
    for (int i = ndigits - 2; i >= 0; i--) {
        pdf417_out_putc(out, (char)('0' + digits[i]));
    }
}

static int pdf417_numeric_compaction(const int *cw, int count, int idx, Pdf417Out *out)
{
    int n = 0;
    int buf[15];
    int end = 0;
    while (idx < count && !end) {
        int code = cw[idx++];
        if (idx == count) end = 1;
        if (code < PDF417_TEXT_LATCH) {
            if (n < 15) buf[n] = code;
            n++;
        } else {
            switch (code) {
            case PDF417_TEXT_LATCH:
            case PDF417_BYTE_LATCH:
            case PDF417_BYTE_LATCH_6:
            case PDF417_MACRO_BEGIN:
            case PDF417_MACRO_OPT:
            case PDF417_MACRO_END:
            case PDF417_ECI_CHARSET:
                idx--;
                end = 1;
                break;
            }
        }
        if ((n % 15 == 0 || code == PDF417_NUMERIC_LATCH || end) && n > 0) {
            int use_n = n > 15 ? 15 : n;
            pdf417_numeric_to_string(buf, use_n, out);
            n = 0;
        }
    }
    return idx;
}

/* Shared high-level dispatch loop (ISO/IEC 15438 5.4 mode-latch handling),
 * starting from an arbitrary codeword index. Full PDF417 always begins with
 * a length-descriptor codeword at index 0 that must be skipped (handled by
 * pdf417_decode_text below, which pre-consumes it via an initial Text
 * compaction call at idx=1). MicroPDF417 has no such length descriptor —
 * codeword 0 is itself a real mode-latch codeword — so
 * pdf417_decode_text_micro instead enters this loop straight from idx=0. */
static int pdf417_dispatch_from(const int *codewords, int count, int idx, Pdf417Out *out)
{
    while (idx < count) {
        int code = codewords[idx++];
        switch (code) {
        case PDF417_TEXT_LATCH:
            idx = pdf417_text_compaction(codewords, count, idx, out);
            break;
        case PDF417_BYTE_LATCH:
        case PDF417_BYTE_LATCH_6:
            idx = pdf417_byte_compaction(code, codewords, count, idx, out);
            break;
        case PDF417_SHIFT_BYTE:
            if (idx >= count) { idx = count; break; }
            pdf417_out_putbyte(out, (unsigned char)codewords[idx++]);
            break;
        case PDF417_NUMERIC_LATCH:
            idx = pdf417_numeric_compaction(codewords, count, idx, out);
            break;
        case PDF417_ECI_CHARSET:
            idx++; /* unsupported, skip designator */
            break;
        case PDF417_ECI_GENERAL:
            idx += 2;
            break;
        case PDF417_ECI_USER:
            idx += 1;
            break;
        case PDF417_MACRO_BEGIN:
        case PDF417_MACRO_OPT:
        case PDF417_MACRO_END:
        case PDF417_READER_INIT:
            /* Macro/reader-init control blocks: not needed by the target
             * sample set; stop cleanly rather than misparse. */
            idx = count;
            break;
        default:
            idx--;
            idx = pdf417_text_compaction(codewords, count, idx, out);
            break;
        }
    }
    return out->len;
}

static int pdf417_decode_text(const int *codewords, int count, char *result_buf, int result_cap)
{
    Pdf417Out out;
    out.buf = result_buf;
    out.len = 0;
    out.cap = result_cap;
    out.buf[0] = '\0';

    if (count <= 0) return 0;

    int idx = pdf417_text_compaction(codewords, count, 1, &out);
    return pdf417_dispatch_from(codewords, count, idx, &out);
}

/* MicroPDF417 variant of the above: no length-descriptor codeword to skip,
 * so the mode dispatch loop starts right at codeword 0. */
static int pdf417_decode_text_micro(const int *codewords, int count, char *result_buf, int result_cap)
{
    Pdf417Out out;
    out.buf = result_buf;
    out.len = 0;
    out.cap = result_cap;
    out.buf[0] = '\0';

    if (count <= 0) return 0;

    return pdf417_dispatch_from(codewords, count, 0, &out);
}


/* ── Section 8: top-level decode + one-shot horizontal-flip retry ───────
 * Polarity inversion is already retried by the caller's multipass
 * (decode_core.c pass2); this file only needs to handle the *_mirror.bmp
 * case, which is a horizontal flip of the whole raster (not a polarity
 * change). PDF417 is a row-stacked linear-symbol code, so mirroring is
 * implemented as a full-image horizontal flip + re-run, matching how the
 * design note describes it (analogous in spirit to datamatrix.c's
 * transpose-and-retry, but a flip is the correct operation for a stacked
 * linear symbology instead of a 2D module matrix).
 */
static int pdf417_decode_internal(const Image *img, BarcodeResult *result)
{
    Pdf417Matrix mat;
    memset(&mat, 0, sizeof(mat));
    if (!pdf417_locate_and_decode_matrix(img, &mat)) return 0;

    int total = mat.rows * mat.cols;
    if (total < 1 || total > PDF417_MAX_CW) { free(mat.codewords); return 0; }

    int *erasure_pos = (int *)malloc(sizeof(int) * (size_t)total);
    int n_erasures = 0;
    for (int i = 0; i < total; i++) {
        if (mat.codewords[i] < 0) {
            erasure_pos[n_erasures++] = i;
            mat.codewords[i] = 0;
        }
    }

    int confidence = 0;
    int ok = pdf417_rs_correct_and_score(mat.codewords, total, mat.ec_level,
                                          erasure_pos, n_erasures, &confidence);
    free(erasure_pos);
    if (!ok) { free(mat.codewords); return 0; }

    int num_ec = 1 << (mat.ec_level + 1);
    int data_len = total - num_ec;
    if (data_len < 1 || mat.codewords[0] != data_len) { free(mat.codewords); return 0; }

    char textbuf[BARCODE_MAX_LEN];
    int outlen = pdf417_decode_text(mat.codewords, data_len, textbuf, (int)sizeof(textbuf));
    free(mat.codewords);
    if (outlen <= 0) return 0;

    memset(result, 0, sizeof(*result));
    int copy_len = outlen < BARCODE_MAX_LEN - 1 ? outlen : BARCODE_MAX_LEN - 1;
    memcpy(result->data, textbuf, (size_t)copy_len);
    result->data[copy_len] = '\0';
    result->length = copy_len;
    result->confidence = confidence;
    result->symbology = BARCODE_SYM_PDF417;
    return 1;
}

static int pdf417_clone_hflip(const Image *in, Image *out)
{
    out->width = in->width;
    out->height = in->height;
    out->pixels = (uint8_t *)malloc((size_t)in->width * (size_t)in->height);
    if (!out->pixels) return -1;
    for (int y = 0; y < in->height; y++) {
        const uint8_t *src = in->pixels + (size_t)y * (size_t)in->width;
        uint8_t *dst = out->pixels + (size_t)y * (size_t)in->width;
        for (int x = 0; x < in->width; x++) dst[x] = src[in->width - 1 - x];
    }
    return 0;
}

int pdf417_decode(const Image *img, BarcodeResult *result)
{
    if (!img || !result || !img->pixels || img->width <= 0 || img->height <= 0) {
        if (result) memset(result, 0, sizeof(*result));
        return 0;
    }
    memset(result, 0, sizeof(*result));

    if (pdf417_decode_internal(img, result)) return 1;

    Image flipped;
    if (pdf417_clone_hflip(img, &flipped) == 0) {
        int ok = pdf417_decode_internal(&flipped, result);
        free(flipped.pixels);
        if (ok) return 1;
    }

    memset(result, 0, sizeof(*result));
    return 0;
}

/* ── Section 9: MicroPDF417 / GS1 Composite CC-A component decode ───────
 * MicroPDF417 (ISO/IEC 24728) reuses the same GF(929) codeword alphabet
 * and 17-module symbol table as full PDF417 (Section 1-4 above), but has
 * no start/stop guard pattern; rows are instead delimited by fixed-width
 * Row Address Pattern (RAP) segments and the whole symbol's row/column
 * geometry is looked up from a small set of ISO-defined variants rather
 * than decoded from row-indicator codewords. GS1 Composite's CC-A/CC-B
 * component (ISO/IEC 24723 Annex) is a MicroPDF417 derivative with its own
 * narrower row layouts (missing the left RAP for 2- and 3-column rows) and
 * its own "general field" bitstream encodation for the data codewords
 * (rather than PDF417 Text/Byte/Numeric compaction).
 *
 * Row/codeword geometry, per-row layouts, EC-count and bit-capacity
 * variant tables, and the general-field bit encodation (Method 1 = plain
 * field, Method 3 = AI(90)) below were reconstructed from the target
 * sample set by direct pixel/codeword-level analysis cross-checked against
 * ISO/IEC 24723 Annex and ISO/IEC 24728 Table 1, and validated end-to-end
 * (RS syndrome all-zero + exact plaintext match) against gs1-128_cca.bmp
 * (CC-A 4-col/3-row, Method 3), gs1-databar-stacked-comp.bmp (CC-A
 * 2-col/6-row, Method 1) and gs1-databar-limited-comp.bmp (CC-A
 * 3-col/4-row without a left RAP, Method 1), plus micropdf.bmp (standard
 * MicroPDF417 3-col/15-row, ISO/IEC 15438 Text compaction).
 */

/* Sample a single image row's dark/light runs, trimmed to the row's own
 * dark-pixel extent (so unrelated whitespace/text elsewhere in the frame
 * doesn't skew the per-module pixel width), and quantize into an exact
 * `total_modules`-length 0/1 module array. These composite/MicroPDF417
 * sample renders are clean axis-aligned synthetic bitmaps (same assumption
 * documented for full PDF417 above), so requiring an exact module-count
 * match is a reliable, low-false-positive row filter. */
static int mcpdf_row_module_bits(const Image *img, int y, int thresh,
                                  int total_modules, int *bits_out)
{
    static Pdf417Run runs[PDF417_MAX_RUNS];
    int n = pdf417_extract_runs(img, y, thresh, runs, PDF417_MAX_RUNS);
    if (n < 3) return 0;

    int first = -1, last = -1;
    for (int i = 0; i < n; i++) {
        if (runs[i].dark) {
            if (first < 0) first = i;
            last = i;
        }
    }
    if (first < 0) return 0;

    int width_px = 0;
    for (int i = first; i <= last; i++) width_px += runs[i].w;
    if (width_px <= 0) return 0;

    double X = (double)width_px / (double)total_modules;
    if (X < 1.2) return 0;

    int bitpos = 0;
    for (int i = first; i <= last && bitpos < total_modules; i++) {
        int nmod = (int)(runs[i].w / X + 0.5);
        for (int k = 0; k < nmod && bitpos < total_modules; k++) {
            bits_out[bitpos++] = runs[i].dark;
        }
    }
    return (bitpos == total_modules) ? 1 : 0;
}

#define MCPDF_MAX_MODULES 100
#define MCPDF_MAX_CW_PER_ROW 4
#define MCPDF_MAX_SEGS 8

typedef struct {
    int rows;
    int ec;
    int bits; /* total general-field bit capacity for this (cols,rows); CC-A only */
} McpdfVariant;

static const McpdfVariant MCPDF_CCA_2COL[] = {
    { 5, 4, 59 }, { 6, 4, 78 }, { 7, 5, 88 }, { 8, 5, 108 },
    { 9, 6, 118 }, { 10, 6, 138 }, { 12, 7, 167 },
};
static const McpdfVariant MCPDF_CCA_3COL[] = {
    { 4, 4, 78 }, { 5, 5, 98 }, { 6, 6, 118 }, { 7, 7, 138 }, { 8, 7, 167 },
};
static const McpdfVariant MCPDF_CCA_4COL[] = {
    { 3, 4, 78 }, { 4, 5, 108 }, { 5, 6, 138 }, { 6, 7, 167 }, { 7, 8, 197 },
};
/* ISO/IEC 24728 Table 1, 3-column standard MicroPDF417 subset (only column
 * count needed by the target sample set); `bits` is unused for this family
 * since standard MicroPDF417 data is decoded via codeword compaction, not
 * the CC-A general-field bitstream. */
static const McpdfVariant MCPDF_STD_3COL[] = {
    { 6, 12, 0 }, { 8, 14, 0 }, { 10, 16, 0 }, { 12, 18, 0 }, { 15, 21, 0 },
    { 20, 26, 0 }, { 26, 32, 0 }, { 32, 38, 0 }, { 38, 44, 0 }, { 44, 50, 0 },
};

typedef struct {
    int total_modules;
    int n_segs;
    int seg_len[MCPDF_MAX_SEGS];
    int seg_is_cw[MCPDF_MAX_SEGS];
    int ncw_per_row;
    int is_cca; /* 1 = GS1 Composite CC-A general-field bitstream; 0 = standard MicroPDF417 codeword compaction */
    const McpdfVariant *variants;
    int n_variants;
} McpdfLayout;

static const McpdfLayout MCPDF_LAYOUTS[] = {
    /* CC-A 4-col: RAP-L + cw + cw + RAP-C + cw + cw + RAP-R + guard = 99 modules */
    { 99, 8, { 10, 17, 17, 10, 17, 17, 10, 1 }, { 0, 1, 1, 0, 1, 1, 0, 0 }, 4, 1,
      MCPDF_CCA_4COL, (int)(sizeof(MCPDF_CCA_4COL) / sizeof(MCPDF_CCA_4COL[0])) },
    /* CC-A 3-col (no left RAP): cw + RAP-C + cw + cw + RAP-R + guard = 72 modules */
    { 72, 6, { 17, 10, 17, 17, 10, 1 }, { 1, 0, 1, 1, 0, 0 }, 3, 1,
      MCPDF_CCA_3COL, (int)(sizeof(MCPDF_CCA_3COL) / sizeof(MCPDF_CCA_3COL[0])) },
    /* CC-A 2-col: RAP-L + cw + cw + RAP-R + guard = 55 modules */
    { 55, 5, { 10, 17, 17, 10, 1 }, { 0, 1, 1, 0, 0 }, 2, 1,
      MCPDF_CCA_2COL, (int)(sizeof(MCPDF_CCA_2COL) / sizeof(MCPDF_CCA_2COL[0])) },
    /* Standard MicroPDF417 3-col: RAP-L + cw + RAP-C + cw + cw + RAP-R + guard = 82 modules */
    { 82, 7, { 10, 17, 10, 17, 17, 10, 1 }, { 0, 1, 0, 1, 1, 0, 0 }, 3, 0,
      MCPDF_STD_3COL, (int)(sizeof(MCPDF_STD_3COL) / sizeof(MCPDF_STD_3COL[0])) },
};

static int mcpdf_lookup_variant(const McpdfVariant *table, int n, int rows,
                                 int *out_ec, int *out_bits)
{
    for (int i = 0; i < n; i++) {
        if (table[i].rows == rows) {
            *out_ec = table[i].ec;
            if (out_bits) *out_bits = table[i].bits;
            return 1;
        }
    }
    return 0;
}

typedef struct {
    int cw[MCPDF_MAX_CW_PER_ROW];
    int cluster;
} McpdfBand;

/* 96-bit (3x32) unsigned big-number accumulator: value*928+add, MSB-first
 * bit extraction. A single MicroPDF417/CC-A "group" is at most 7 codewords
 * (values 0..928), whose base-928 value needs at most 69 bits -- 96 bits of
 * headroom is ample and keeps the arithmetic simple (no >64-bit type
 * dependency). */
typedef struct { uint32_t w[3]; } Mcpdf96;

static void mcpdf96_zero(Mcpdf96 *a) { a->w[0] = a->w[1] = a->w[2] = 0; }

static void mcpdf96_muladd(Mcpdf96 *a, uint32_t mul, uint32_t add)
{
    uint64_t carry = add;
    for (int i = 0; i < 3; i++) {
        uint64_t v = (uint64_t)a->w[i] * mul + carry;
        a->w[i] = (uint32_t)(v & 0xFFFFFFFFu);
        carry = v >> 32;
    }
}

/* bit_from_msb: 0 = most significant bit of the `total_bits`-bit number. */
static int mcpdf96_get_bit(const Mcpdf96 *a, int bit_from_msb, int total_bits)
{
    int bit_index = total_bits - 1 - bit_from_msb;
    if (bit_index < 0) return 0;
    int word = bit_index / 32;
    int off = bit_index % 32;
    if (word > 2) return 0;
    return (int)((a->w[word] >> off) & 1u);
}

/* ── GS1 Composite CC-A "general field" bit decodation ───────────────── */

typedef struct {
    const int *bits;
    int len;
    int pos;
} McpdfBitReader;

static int mcpdf_br_take(McpdfBitReader *br, int n, int *out_val)
{
    if (br->pos + n > br->len) return 0;
    int v = 0;
    for (int i = 0; i < n; i++) v = (v << 1) | br->bits[br->pos + i];
    br->pos += n;
    if (out_val) *out_val = v;
    return 1;
}

static int mcpdf_br_peek_zero(McpdfBitReader *br, int n)
{
    if (br->pos + n > br->len) return 0;
    for (int i = 0; i < n; i++) {
        if (br->bits[br->pos + i] != 0) return 0;
    }
    return 1;
}

/* Three-mode (Numeric / Alphanumeric / ISO646) general-purpose field
 * decodation shared by AI(90) (Method 3) and plain (Method 1) fields.
 * Validated bit-for-bit against three independent samples (see Section 9
 * header comment). Runs until the bitstream is exhausted (any remaining
 * bits too short for the next code are trailing pad, not an error) or an
 * FNC1 codeword is seen (treated as a clean field terminator). */
typedef enum { MCPDF_MODE_NUM, MCPDF_MODE_ALNUM, MCPDF_MODE_ISO646 } McpdfFieldMode;

static void mcpdf_general_field_decode(McpdfBitReader *br, Pdf417Out *out, McpdfFieldMode start_mode)
{
    static const char PUNCT6[5] = { '*', ',', '-', '.', '/' };
    McpdfFieldMode mode = start_mode;
    enum { MODE_NUM = MCPDF_MODE_NUM, MODE_ALNUM = MCPDF_MODE_ALNUM, MODE_ISO646 = MCPDF_MODE_ISO646 };

    for (;;) {
        if (mode == MODE_NUM) {
            if (mcpdf_br_peek_zero(br, 4)) {
                br->pos += 4;
                mode = MODE_ALNUM;
                continue;
            }
            int v7;
            if (!mcpdf_br_take(br, 7, &v7)) break;
            int cv = v7 - 8;
            if (cv >= 0 && cv <= 120) {
                int d1 = cv / 11, d2 = cv % 11;
                if (d1 <= 9) pdf417_out_putc(out, (char)('0' + d1));
                if (d2 <= 9) pdf417_out_putc(out, (char)('0' + d2));
                else if (d2 == 10) { /* FNC1 digit pair terminator */ }
            }
        } else if (mode == MODE_ALNUM) {
            if (mcpdf_br_peek_zero(br, 3)) {
                br->pos += 3;
                mode = MODE_NUM;
                continue;
            }
            int v5;
            if (!mcpdf_br_take(br, 5, &v5)) break;
            if (v5 == 4) { mode = MODE_ISO646; continue; }
            if (v5 == 15) break; /* FNC1 */
            if (v5 >= 5 && v5 <= 14) { pdf417_out_putc(out, (char)('0' + (v5 - 5))); continue; }
            if (v5 >= 16) {
                int b6;
                if (!mcpdf_br_take(br, 1, &b6)) break;
                int v6 = v5 * 2 + b6;
                if (v6 >= 32 && v6 <= 57) pdf417_out_putc(out, (char)(v6 + 33));
                else if (v6 >= 58 && v6 <= 62) pdf417_out_putc(out, PUNCT6[v6 - 58]);
                continue;
            }
            break;
        } else { /* MODE_ISO646 */
            if (mcpdf_br_peek_zero(br, 3)) {
                br->pos += 3;
                mode = MODE_NUM;
                continue;
            }
            int v5;
            if (!mcpdf_br_take(br, 5, &v5)) break;
            if (v5 == 4) { mode = MODE_ALNUM; continue; }
            if (v5 == 15) break; /* FNC1 */
            if (v5 >= 5 && v5 <= 14) { pdf417_out_putc(out, (char)('0' + (v5 - 5))); continue; }
            if (v5 >= 16) {
                int e2;
                if (!mcpdf_br_take(br, 2, &e2)) break;
                int v7 = v5 * 4 + e2;
                if (v7 >= 64 && v7 <= 89) pdf417_out_putc(out, (char)(v7 + 1));       /* uppercase, c-1 */
                else if (v7 >= 90 && v7 <= 115) pdf417_out_putc(out, (char)(v7 + 7)); /* lowercase, c-7 */
                continue;
            }
            break;
        }
    }
}

/* CC-A data field header: leading '0' = Method 1 (general field starts
 * directly, in Numeric mode); leading "11" = Method 3 (AI(90) compressed
 * header: 2-bit method + 1-2 bit sub-mode + 1-bit crop + 5(+10)-bit value +
 * 4-bit letter, then the general field continues in Alphanumeric mode).
 * Leading "10" is a third method (not exercised by the target sample set,
 * left unimplemented per the design note) -- decode fails cleanly. */
static int mcpdf_cca_decode_bits(const int *bits, int total_bits, char *out_buf, int out_cap)
{
    Pdf417Out out;
    out.buf = out_buf;
    out.len = 0;
    out.cap = out_cap;
    out_buf[0] = '\0';
    if (total_bits < 1) return 0;

    McpdfBitReader br;
    br.bits = bits;
    br.len = total_bits;
    br.pos = 0;

    if (bits[0] == 0) {
        br.pos = 1;
        mcpdf_general_field_decode(&br, &out, MCPDF_MODE_NUM);
        return out.len;
    }

    if (total_bits >= 2 && bits[0] == 1 && bits[1] == 1) {
        br.pos = 2;
        int mode_bit;
        if (!mcpdf_br_take(&br, 1, &mode_bit)) return 0;
        int submode = 0; /* 0 = alnum (validated), 1 = numeric, 2 = alpha (unsupported) */
        if (mode_bit != 0) {
            int b2;
            if (!mcpdf_br_take(&br, 1, &b2)) return 0;
            submode = (b2 == 0) ? 1 : 2;
        }
        if (submode != 0) return 0;

        int crop_bit;
        if (!mcpdf_br_take(&br, 1, &crop_bit)) return 0;
        int val5;
        if (!mcpdf_br_take(&br, 5, &val5)) return 0;
        int value = val5;
        if (val5 == 31) {
            int val10;
            if (!mcpdf_br_take(&br, 10, &val10)) return 0;
            value = val10;
        }
        int letter_idx;
        if (!mcpdf_br_take(&br, 4, &letter_idx)) return 0;
        static const char LETTER_TBL[16] = {
            'B', 'D', 'H', 'I', 'J', 'K', 'L', 'N',
            'P', 'Q', 'R', 'S', 'T', 'V', 'W', 'Z',
        };
        if (letter_idx < 0 || letter_idx >= 16) return 0;

        pdf417_out_putc(&out, '9');
        pdf417_out_putc(&out, '0');
        char numbuf[16];
        int nlen = snprintf(numbuf, sizeof(numbuf), "%d", value);
        for (int i = 0; i < nlen; i++) pdf417_out_putc(&out, numbuf[i]);
        pdf417_out_putc(&out, LETTER_TBL[letter_idx]);

        mcpdf_general_field_decode(&br, &out, MCPDF_MODE_ALNUM);
        return out.len;
    }

    return 0; /* Method 2 ("10" prefix): not implemented */
}

/* ── Row/geometry scan + per-layout decode driver ────────────────────── */

static int micropdf_try_layout(const Image *img, int thresh, const McpdfLayout *layout,
                                BarcodeResult *result)
{
    int H = img->height;
    McpdfBand *bands = (McpdfBand *)malloc(sizeof(McpdfBand) * (size_t)H);
    if (!bands) return 0;
    int n_bands = 0;
    McpdfBand prev;
    int have_prev = 0;
    int modbits[MCPDF_MAX_MODULES];

    for (int y = 0; y < H; y++) {
        if (!mcpdf_row_module_bits(img, y, thresh, layout->total_modules, modbits)) {
            have_prev = 0;
            continue;
        }
        int pos = 0, ncw = 0, cluster = -1, ok = 1;
        int cw[MCPDF_MAX_CW_PER_ROW];
        for (int s = 0; s < layout->n_segs; s++) {
            int len = layout->seg_len[s];
            if (layout->seg_is_cw[s]) {
                uint32_t val = 0;
                for (int k = 0; k < len; k++) val = (val << 1) | (uint32_t)modbits[pos + k];
                int clu = -1;
                int v = pdf417_symbol_table_lookup(val, &clu);
                if (v < 0) { ok = 0; break; }
                if (cluster < 0) cluster = clu;
                else if (cluster != clu) { ok = 0; break; }
                if (ncw >= MCPDF_MAX_CW_PER_ROW) { ok = 0; break; }
                cw[ncw++] = v;
            }
            pos += len;
        }
        if (!ok || ncw != layout->ncw_per_row) {
            have_prev = 0;
            continue;
        }
        if (have_prev && prev.cluster == cluster &&
            memcmp(prev.cw, cw, sizeof(int) * (size_t)ncw) == 0) {
            continue; /* same physical row as the previous matched pixel row */
        }
        if (n_bands < H) {
            memcpy(bands[n_bands].cw, cw, sizeof(int) * (size_t)ncw);
            bands[n_bands].cluster = cluster;
            n_bands++;
        }
        memcpy(prev.cw, cw, sizeof(int) * (size_t)ncw);
        prev.cluster = cluster;
        have_prev = 1;
    }

    if (n_bands < 2) { free(bands); return 0; }

    int ec = 0, bitcap = 0;
    if (!mcpdf_lookup_variant(layout->variants, layout->n_variants, n_bands, &ec, &bitcap)) {
        free(bands);
        return 0;
    }

    int total_cw = n_bands * layout->ncw_per_row;
    if (total_cw < 1 || total_cw > PDF417_MAX_CW) { free(bands); return 0; }
    int *codewords = (int *)malloc(sizeof(int) * (size_t)total_cw);
    if (!codewords) { free(bands); return 0; }
    for (int i = 0; i < n_bands; i++) {
        for (int k = 0; k < layout->ncw_per_row; k++) {
            codewords[i * layout->ncw_per_row + k] = bands[i].cw[k];
        }
    }
    free(bands);

    int confidence = 0;
    if (!pdf417_rs_correct_and_score_ex(codewords, total_cw, ec, NULL, 0, &confidence)) {
        free(codewords);
        return 0;
    }

    int data_len = total_cw - ec;
    if (data_len < 1) { free(codewords); return 0; }

    char textbuf[BARCODE_MAX_LEN];
    int outlen;
    if (layout->is_cca) {
        int bits[256];
        int bitpos = 0;
        int i = 0;
        int nfull = data_len / 7;
        int remainder = data_len % 7;
        for (int g = 0; g < nfull; g++) {
            Mcpdf96 acc;
            mcpdf96_zero(&acc);
            for (int k = 0; k < 7; k++) mcpdf96_muladd(&acc, 928, (uint32_t)codewords[i + k]);
            for (int b = 0; b < 69 && bitpos < 256; b++) bits[bitpos++] = mcpdf96_get_bit(&acc, b, 69);
            i += 7;
        }
        if (remainder > 0) {
            int last_bits = bitcap - 69 * nfull;
            if (last_bits < 0) last_bits = 0;
            if (last_bits > 96) last_bits = 96;
            Mcpdf96 acc;
            mcpdf96_zero(&acc);
            for (int k = 0; k < remainder; k++) mcpdf96_muladd(&acc, 928, (uint32_t)codewords[i + k]);
            for (int b = 0; b < last_bits && bitpos < 256; b++) {
                bits[bitpos++] = mcpdf96_get_bit(&acc, b, last_bits);
            }
            i += remainder;
        }
        outlen = mcpdf_cca_decode_bits(bits, bitpos, textbuf, (int)sizeof(textbuf));
    } else {
        outlen = pdf417_decode_text_micro(codewords, data_len, textbuf, (int)sizeof(textbuf));
    }
    free(codewords);
    if (outlen <= 0) return 0;

    memset(result, 0, sizeof(*result));
    int copy_len = outlen < BARCODE_MAX_LEN - 1 ? outlen : BARCODE_MAX_LEN - 1;
    memcpy(result->data, textbuf, (size_t)copy_len);
    result->data[copy_len] = '\0';
    result->length = copy_len;
    result->confidence = confidence;
    result->symbology = BARCODE_SYM_PDF417;
    return 1;
}

int micropdf417_decode(const Image *img, BarcodeResult *result)
{
    if (!img || !result || !img->pixels || img->width <= 0 || img->height <= 0) {
        if (result) memset(result, 0, sizeof(*result));
        return 0;
    }
    memset(result, 0, sizeof(*result));

    int thresh = pdf417_otsu_threshold(img);
    for (size_t li = 0; li < sizeof(MCPDF_LAYOUTS) / sizeof(MCPDF_LAYOUTS[0]); li++) {
        if (micropdf_try_layout(img, thresh, &MCPDF_LAYOUTS[li], result)) return 1;
    }

    Image flipped;
    if (pdf417_clone_hflip(img, &flipped) == 0) {
        int thresh2 = pdf417_otsu_threshold(&flipped);
        for (size_t li = 0; li < sizeof(MCPDF_LAYOUTS) / sizeof(MCPDF_LAYOUTS[0]); li++) {
            if (micropdf_try_layout(&flipped, thresh2, &MCPDF_LAYOUTS[li], result)) {
                free(flipped.pixels);
                return 1;
            }
        }
        free(flipped.pixels);
    }

    memset(result, 0, sizeof(*result));
    return 0;
}
